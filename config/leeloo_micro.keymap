#undef HAVE_NUMROW
#undef HAVE_6COL

#define LEFT_KEYS                               \
  0  1  2  3  4                                 \
  10 11 12 13 14                                \
  20 21 22 23 24 25
#define RIGHT_KEYS                              \
  5  6  7  8  9                                 \
  15 16 17 18 19                                \
  26 27 28 29 30 31
#define THUMB_KEYS                              \
  32 33 34 35                                   \
  36 37 38 29

#define LEELOO_MICRO

#define QW <0 1>

#include "common.keymap"

// Local Variables:
// mode: c
// c-basic-offset: 2
// End:
