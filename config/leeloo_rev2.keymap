#define HAVE_NUMROW
#define HAVE_6COLS

#define LEFT_KEYS                               \
  0  1  2  3  4  5                              \
  12 13 14 15 16 17                             \
  24 25 26 27 28 29                             \
  36 37 38 39 40 41 42
#define RIGHT_KEYS                              \
  6  7  8  9  10 11                             \
  18 19 20 21 22 23                             \
  30 31 32 33 34 35                             \
  43 44 45 46 47 48 49
#define THUMB_KEYS                              \
  50 51 52 53                                   \
  53 54 55 56

#define LEELOO_REV2

#define QW <12 13>

#include "common.keymap"

// Local Variables:
// mode: c
// c-basic-offset: 2
// End:
