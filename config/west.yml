## config/west.yml
```yaml
manifest:
  remotes:
    - name: zmkfirmware
      url-base: https://github.com/zmkfirmware
    - name: clicketysplit
      url-base: https://github.com/clicketysplit
    - name: jasonish
      url-base: https://github.com/jasonish
  projects:
    - name: zmk
      remote: jasonish
      revision: jasonish-leeloo
      import: app/west.yml
  self:
    path: config
```
